## BR/ext_demo/Config.in
```kconfig
source "$BR2_EXTERNAL_DEMO_PATH/package/hello_autotools/Config.in"
source "$BR2_EXTERNAL_DEMO_PATH/package/hello_cmake/Config.in"
source "$BR2_EXTERNAL_DEMO_PATH/package/hello_generic/Config.in"
source "$BR2_EXTERNAL_DEMO_PATH/package/hello_proc/Config.in"
```

## BR/ext_demo/configs/raspberrypi3_le5_defconfig
```kconfig
BR2_arm=y
BR2_cortex_a7=y
BR2_ARM_FPU_NEON_VFPV4=y
BR2_TOOLCHAIN_EXTERNAL=y
BR2_SYSTEM_DHCP="eth0"
BR2_ROOTFS_POST_BUILD_SCRIPT="board/raspberrypi3/post-build.sh"
BR2_ROOTFS_POST_IMAGE_SCRIPT="board/raspberrypi3/post-image.sh"
BR2_ROOTFS_POST_SCRIPT_ARGS="--add-pi3-miniuart-bt-overlay"
BR2_LINUX_KERNEL_CUSTOM_GIT=y
BR2_LINUX_KERNEL_CUSTOM_REPO_URL="https://github.com/raspberrypi/linux.git"
BR2_LINUX_KERNEL_CUSTOM_REPO_VERSION="1ebe8d4a4c96cd6a90805c74233a468854960f67"
BR2_LINUX_KERNEL_DEFCONFIG="bcm2709"
BR2_LINUX_KERNEL_DTS_SUPPORT=y
BR2_LINUX_KERNEL_INTREE_DTS_NAME="bcm2710-rpi-3-b"
BR2_PACKAGE_RPI_FIRMWARE=y
BR2_TARGET_ROOTFS_EXT2=y
BR2_TARGET_ROOTFS_EXT2_4=y
# BR2_TARGET_ROOTFS_TAR is not set
BR2_PACKAGE_HOST_DOSFSTOOLS=y
BR2_PACKAGE_HOST_GENIMAGE=y
BR2_PACKAGE_HOST_MTOOLS=y
BR2_PACKAGE_HELLO_GENERIC=y
BR2_PACKAGE_HELLO_PROC=y
```

## BR/ext_demo/package/hello_autotools/Config.in
```kconfig
config BR2_PACKAGE_HELLO_AUTOTOOLS
	bool "Autotools example"
	help
	  Hello World Autotools package
```

## BR/ext_demo/package/hello_cmake/Config.in
```kconfig
config BR2_PACKAGE_HELLO_CMAKE
	bool "CMake example"
	help
	  Hello CMake package
```

## BR/ext_demo/package/hello_generic/Config.in
```kconfig
config BR2_PACKAGE_HELLO_GENERIC
	bool "Generic Makefile example"
	help
	  Hello World generic package
```

## BR/ext_demo/package/hello_proc/Config.in
```kconfig
config BR2_PACKAGE_HELLO_PROC
	bool "hello proc module"
	select BR2_LINUX_KERNEL
	help
	  hello /proc module
```

## BR/ext_demo/package/pcsensor/Config.in
```kconfig
config BR2_PACKAGE_PCSENSOR
	bool "PCSENSOR utility"
	select BR2_PACKAGE_LIBUSB_COMPAT
	select BR2_PACKAGE_LIBUSB
	help
		PCSENSOR utility
```

## Yocto/meta-le5-bis/conf/layer.conf
```bitbake
# We have a conf and classes directory, add to BBPATH
BBPATH .= ":${LAYERDIR}"

# We have recipes-* directories, add to BBFILES
BBFILES += "${LAYERDIR}/recipes-*/*/*.bb \
	${LAYERDIR}/recipes-*/*/*.bbappend"

BBFILE_COLLECTIONS += "meta-le5-bis"
BBFILE_PATTERN_meta-le5-bis = "^${LAYERDIR}/"
BBFILE_PRIORITY_meta-le5-bis = "7"
```

## Yocto/meta-le5/conf/distro/le5-distro.conf
```bitbake
require conf/distro/poky.conf      
DISTRO = "le5-distro"
DISTRO_NAME = "Poky based LE5 example distribution"
DISTRO_VERSION = "1.0+snapshot-${DATE}"
```

## dev_le/Ftrace/raspberrypi3_64_ftrace_defconfig
```kconfig
BR2_aarch64=y
BR2_ARM_FPU_VFPV4=y
BR2_TOOLCHAIN_EXTERNAL=y
BR2_TARGET_GENERIC_ROOT_PASSWD="tototiti"
BR2_SYSTEM_DHCP="eth0"
BR2_ROOTFS_POST_BUILD_SCRIPT="board/raspberrypi3-64/post-build.sh"
BR2_ROOTFS_POST_IMAGE_SCRIPT="board/raspberrypi3-64/post-image.sh"
BR2_ROOTFS_POST_SCRIPT_ARGS="--aarch64"
BR2_LINUX_KERNEL=y
BR2_LINUX_KERNEL_CUSTOM_GIT=y
BR2_LINUX_KERNEL_CUSTOM_REPO_URL="https://github.com/raspberrypi/linux.git"
BR2_LINUX_KERNEL_CUSTOM_REPO_VERSION="5e4ee836560d4c0371e109bf469e1ad808ae7a44"
BR2_LINUX_KERNEL_DEFCONFIG="bcmrpi3"
BR2_LINUX_KERNEL_DTS_SUPPORT=y
BR2_LINUX_KERNEL_INTREE_DTS_NAME="broadcom/bcm2710-rpi-3-b broadcom/bcm2837-rpi-3-b"
BR2_PACKAGE_LINUX_TOOLS_PERF=y
BR2_PACKAGE_STRACE=y
BR2_PACKAGE_TRACE_CMD=y
BR2_PACKAGE_RPI_FIRMWARE=y
# BR2_PACKAGE_RPI_FIRMWARE_INSTALL_DTB_OVERLAYS is not set
BR2_PACKAGE_DROPBEAR=y
BR2_TARGET_ROOTFS_EXT2=y
BR2_TARGET_ROOTFS_EXT2_4=y
BR2_TARGET_ROOTFS_EXT2_BLOCKS=120000
# BR2_TARGET_ROOTFS_TAR is not set
BR2_PACKAGE_HOST_DOSFSTOOLS=y
BR2_PACKAGE_HOST_GENIMAGE=y
BR2_PACKAGE_HOST_MTOOLS=y
```

## etude_cas/meta-iot/conf/layer.conf
```bitbake
# We have a conf and classes directory, add to BBPATH
BBPATH .= ":${LAYERDIR}"

# We have recipes-* directories, add to BBFILES
BBFILES += "${LAYERDIR}/recipes-*/*/*.bb \
	${LAYERDIR}/recipes-*/*/*.bbappend"

BBFILE_COLLECTIONS += "meta-iot-jdev"
BBFILE_PATTERN_meta-iot-jdev = "^${LAYERDIR}/"
BBFILE_PRIORITY_meta-iot-jdev = "6"
```
